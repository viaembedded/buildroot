## configs/via_apc8750_defconfig
```kconfig
BR2_arm=y
BR2_arm1176jzf_s=y

# Debug UART
BR2_TARGET_GENERIC_GETTY_PORT="ttyWMT0"

BR2_KERNEL_HEADERS_VERSION=y
BR2_DEFAULT_KERNEL_VERSION="3.13"
BR2_PACKAGE_HOST_LINUX_HEADERS_CUSTOM_3_13=y

BR2_LINUX_KERNEL=y
BR2_LINUX_KERNEL_CUSTOM_GIT=y
BR2_LINUX_KERNEL_CUSTOM_REPO_URL="git://github.com/linux-wmt/linux-vtwm.git"
BR2_LINUX_KERNEL_CUSTOM_REPO_VERSION="testing"
BR2_LINUX_KERNEL_DEFCONFIG="vt8500_v6_v7"
BR2_LINUX_KERNEL_APPENDED_UIMAGE=y
BR2_LINUX_KERNEL_INTREE_DTS_NAME="wm8750-apc8750"
# In u-boot have to load from 0x01000000
BR2_LINUX_KERNEL_UIMAGE_LOADADDR="0x00400000"
```

## configs/via_imx6_vab820_defconfig
```kconfig
# architecture
BR2_arm=y
BR2_cortex_a9=y

# toolchain
BR2_KERNEL_HEADERS_VERSION=y
BR2_DEFAULT_KERNEL_VERSION="3.0.35"
BR2_PACKAGE_HOST_LINUX_HEADERS_CUSTOM_3_0=y
BR2_GCC_VERSION_4_7_X=y

# system
BR2_TARGET_GENERIC_GETTY_PORT="ttymxc1"

# kernel
BR2_LINUX_KERNEL=y
BR2_LINUX_KERNEL_CUSTOM_GIT=y
BR2_LINUX_KERNEL_CUSTOM_REPO_URL="git://github.com/viaembedded/vab820-kernel-bsp.git"
BR2_LINUX_KERNEL_CUSTOM_REPO_VERSION="via_3.0.35"
BR2_LINUX_KERNEL_DEFCONFIG="imx6"
BR2_LINUX_KERNEL_UIMAGE_LOADADDR="0x10008000"
BR2_LINUX_KERNEL_UBOOT_IMAGE=y
BR2_LINUX_KERNEL_UIMAGE=y

# bootloader
BR2_TARGET_UBOOT=y
BR2_TARGET_UBOOT_BOARDNAME="mx6q_sabrelite"
BR2_TARGET_UBOOT_CUSTOM_GIT=y
BR2_TARGET_UBOOT_CUSTOM_REPO_URL="git://github.com/viaembedded/vab820-uboot-bsp.git"
BR2_TARGET_UBOOT_CUSTOM_REPO_VERSION="via_3.0.35"
BR2_TARGET_UBOOT_CUSTOM_PATCH_DIR="board/via/imx6_vab820"
BR2_TARGET_UBOOT_FORMAT_BIN=y

# rootfs
BR2_TARGET_ROOTFS_TAR=y

# post-build
BR2_ROOTFS_POST_IMAGE_SCRIPT="board/via/imx6_vab820/post-build.sh"
```

## configs/via_springboard_defconfig
```kconfig
BR2_arm=y
BR2_cortex_a9=y

# Kernel Header Options
BR2_KERNEL_HEADERS_3_0=y

# getty options
BR2_TARGET_GENERIC_GETTY_PORT="tty0"

# initramfs needs a Linux kernel to be built
BR2_TARGET_ROOTFS_TAR=y
BR2_TARGET_ROOTFS_TAR_GZIP=y
```
